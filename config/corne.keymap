#include <behaviors.dtsi>
#include <behaviors/num_word.dtsi> // Requires zmk-auto-layer module.
#include <behaviors/unicode.dtsi> // Requires zmk-unicode module.
#include <zmk-helpers/helper.h> // Requires zmk-helpers module.
#include <zmk-helpers/key-labels/42.h>
#include <dt-bindings/zmk/keys.h>
#include <dt-bindings/zmk/bt.h>
#include <dt-bindings/zmk/outputs.h>
#include "layout/corne-keys.dtsi"
#include "layout/specialkeys.dtsi"

#define _BT_SEL_KEYS_                                                        \
    &bt BT_SEL 0 &bt BT_SEL 1 &bt BT_SEL 2 &bt BT_SEL 3 &bt BT_CLR

// LETTERS
#define QWERTY 0
// NAVIGATION
#define NAV 1
// FUNCTIONS
#define FN 2
// NUMBERS
#define NUM 3
// SYMBOLS
#define SYM 4
// SYSTEM
#define SYS 5
// MOUSE
#define MS 6
// TOGGLE LAYERS
#define LAYERS 7

# define MEDIA 8

// GLOBALS
#define QUICK_TAP_MS 175

&sk {
  release-after-ms = <900>;
  quick-release;
};

&sl { // Allow sticky mods to chord across sticky layers.
  ignore-modifiers;
};

&lt {
  flavor = "balanced";
  tapping-term-ms = <200>;
  quick-tap-ms = <QUICK_TAP_MS>;
};

#include "layout/combos.dtsi" // Must be sourced after HRM-combo hack.
#include "layout/leader.dtsi"
#include "layout/mouse.dtsi"
#include "layout/homerow.dtsi"

// Trigger tap-action on all interrupts.
#define MT_CORE                                                                \
  flavor = "tap-preferred";                                                    \
  tapping-term-ms = <220>;                                                     \
  quick-tap-ms = <220>;                                                        \
  hold-trigger-key-positions = <0>;

&mt { MT_CORE };

/* Magic-shift & auto-layers */

// Tap: repeat after alpha, else sticky-shift |
// Shift + tap/ double-tap: caps-word | Hold: shift.
#define MAGIC_SHIFT &magic_shift LSHFT 0
ZMK_HOLD_TAP(magic_shift, bindings = <&kp>, <&magic_shift_tap>;
             flavor = "balanced"; tapping-term-ms = <200>;
             quick-tap-ms = <QUICK_TAP_MS>;)
ZMK_MOD_MORPH(magic_shift_tap, bindings = <&shift_repeat>, <&caps_word>;
              mods = <(MOD_LSFT)>;)
ZMK_ADAPTIVE_KEY(
    shift_repeat, bindings = <&sk LSHFT>;
    repeat {
      trigger-keys = <A B C D E F G H I J K L M N O P Q R S T U V W X Y Z>;
      bindings = <&key_repeat>;
      max-prior-idle-ms = <1200>;
      strict-modifiers;
    };)

    &caps_word { // Mods deactivate caps-word, requires PR #1451. [TODO: rebase]
  /delete-property/ ignore-modifiers;
};

// Tap: num-word | double-tap: sticky num-layer | Hold: num-layer.
#define SMART_NUM &smart_num NUM 0
ZMK_HOLD_TAP(smart_num, bindings = <&mo>, <&num_dance>; flavor = "balanced";
             tapping-term-ms = <200>; quick-tap-ms = <QUICK_TAP_MS>;)
ZMK_TAP_DANCE(num_dance, bindings = <&mo NUM>, <&sl NUM>;
              tapping-term-ms = <200>;)


// Define mod-morph with a *single* mod trigger for less repetition.
#define SIMPLE_MORPH(NAME, MOD, BINDING1, BINDING2)                            \
  ZMK_MOD_MORPH(NAME, mods = <(MOD_L##MOD | MOD_R##MOD)>;                      \
                bindings = <BINDING1>, <BINDING2>;)

// Tap: space | Shift + tap: dot -> space -> sticky shift | Hold: nav layer.
ZMK_HOLD_TAP(lt_spc, bindings = <&mo>, <&spc_morph>; flavor = "balanced";
             tapping-term-ms = <200>; quick-tap-ms = <QUICK_TAP_MS>;)
SIMPLE_MORPH(spc_morph, SFT, &kp SPACE, &dot_spc)
ZMK_MACRO(dot_spc, bindings = <&kp DOT &kp SPACE &sk LSHFT>; wait-ms = <0>;
          tap-ms = <5>;)

// Tap: backspace | Lshft + tap: delete | Rshft + tap: shift-delete.
ZMK_MOD_MORPH(bs_del, bindings = <&kp BSPC>, <&kp DEL>;
              mods = <(MOD_LSFT|MOD_RSFT)>; keep-mods = <MOD_RSFT>;)

// Tap: copy | double-tap: cut.
ZMK_TAP_DANCE(copy_cut, bindings = <&kp LC(INS)>, <&kp LC(X)>;
              tapping-term-ms = <200>;)

// Sticky shift + leader.
ZMK_MACRO(leader_sft, bindings = <&sk LSHFT &leader>;)


/* Keymap */
ZMK_CONDITIONAL_LAYER(sys, SYM NUM, SYS) // SYM + NUM --> SYS.

/ {
  behaviors {
    // Tap: Single quote  ("'")
    // Shift-tap: Double quote ('"')
    // Double-tap: Turn on CAPS_WORD
    // Hold: -
    // Morph: -
    sqtcaps: singlequote_or_capsword {
      compatible = "zmk,behavior-tap-dance";
      #binding-cells = <0>;
      tapping-term-ms = <200>;
      bindings = <&kp SQT>, <&caps_word>;
    };

    appswtnxt: application_switch_next {
      compatible = "zmk,behavior-tri-state";
      #binding-cells = <0>;
      bindings = <&kt LGUI>, <&kp TAB>, <&kt LGUI>;
      ignored-key-positions = <LT5 LM5>;
    };

    winswtnxt: window_switch_next {
      compatible = "zmk,behavior-tri-state";
      #binding-cells = <0>;
      bindings = <&kt LGUI>, <&kp GRAVE>, <&kt LGUI>;
      ignored-key-positions = <LB5 LM5>;
    };

    appPwinN: application_switch_previous_window_next {
      compatible = "zmk,behavior-mod-morph";
      #binding-cells = <0>;
      bindings = <&winswtnxt>, <&kp GRAVE>;
      mods = <(MOD_LGUI|MOD_RGUI)>;
      keep-mods = <(MOD_LGUI|MOD_RGUI)>;
    };

    winPglobe: window_previous_globe {
      compatible = "zmk,behavior-mod-morph";
      #binding-cells = <0>;
      bindings = <&kp GLOBE>, <&kp TILDE>;
      mods = <(MOD_LGUI|MOD_RGUI)>;
      keep-mods = <(MOD_LGUI|MOD_RGUI)>;
    };
  };
};

/ {

  keymap {
    compatible = "zmk,keymap";
    qwerty {
// -----------------------------------------------------------------------------------------------------------------------------
// |  ESC     |   Q    |   W    |     E     |     R     |     T     | # |    Y     |    U     |    I    |    O   |   '    |     |
// |  TAB     | A/LGUI | R/LALT |  S/LCTRL  |  T/LSHFT  |     G     | # |     M     | N/LSHFT  | E/LCTRL | I/LALT | O/LGUI |     |
// |  LSHIFT  |   Z    | X/RALT |     C     |     D     |     V     | # |     K     |    H     |    ,    | ./RALT |   /    |     |
//                              |    LCTR   | SPACE/NAV | SYM/ENTER | # | ENTER/SYM | BSPC/NUM |  MOUSE  |
      bindings = <
    &kp ESC     &kp Q       &kp W           &kp E         &kp R          &kp T                &kp Y          &kp U         &kp I          &kp O         &kp P          &kp BSPC
    &kp TAB     &mt LGUI A  &mt LALT S      &mt LCTRL D   &mt LSHFT F    &kp G                &kp H          &mt LSHFT J   &mt LCTRL K    &mt LALT L    &mt LGUI SEMI  &kp RET
    &kp LSHIFT  &kp Z       &kp X           &kp C         &kp V          &kp B                &kp N          &kp M         &kp COMMA       &mt RALT DOT  &kp FSLH       &kp RSHFT
                                            &kp LCTRL     &lt NAV SPACE  &lt SYM ENTER        &mo NUM        &kp RSHFT     &mo MS
       >;
    };


    nav {
// ---------------------------------------------------------------------------------------------
// |      |     |     |     |     |     | # |     |     |       |         |     |     |
// |      |     |     |     |     |     | # |     |     |       |         |      |     |
// |      |     |     |     |     |     | # |     |     |       |         |      |     |
//                    |     |     |     | # |     |     |       |

      bindings = <
&trans  &trans  &trans  &trans  &trans  &trans        &trans  &trans  &trans    &trans    &trans  &trans
&trans  &trans  &trans  &trans  &trans  &trans        &trans  &trans  &trans    &trans    &trans  &trans
&trans  &trans  &trans  &trans  &trans  &trans        &trans  &trans  &trans    &trans    &trans  &trans
                        &trans  &trans  &trans        &trans  &trans  &trans
      >;
  };

    functions {
// ---------------------------------------------------------------------------------------------
// |      |     |     |     |     |     | # |     |     |       |         |     |     |
// |      |     |     |     |     |     | # |     |     |       |         |      |     |
// |      |     |     |     |     |     | # |     |     |       |         |      |     |
//                    |     |     |     | # |     |     |       |

    bindings = <
&trans  &trans  &trans  &trans  &trans  &trans        &trans  &trans  &trans    &trans    &trans  &trans
&trans  &trans  &trans  &trans  &trans  &trans        &trans  &trans  &trans    &trans    &trans  &trans
&trans  &trans  &trans  &trans  &trans  &trans        &trans  &trans  &trans    &trans    &trans  &trans
                    &trans  &trans  &trans        &trans  &trans  &trans
              >;
  };
    numbers {
// ---------------------------------------------------------------------------------------------
// |      |     |     |     |     |     | # |     |     |       |         |     |     |
// |      |     |     |     |     |     | # |     |     |       |         |      |     |
// |      |     |     |     |     |     | # |     |     |       |         |      |     |
//                    |     |     |     | # |     |     |       |

    bindings = <
&trans  &trans  &trans  &trans  &trans  &trans        &trans  &trans  &trans    &trans    &trans  &trans
&trans  &trans  &trans  &trans  &trans  &trans        &trans  &trans  &trans    &trans    &trans  &trans
&trans  &trans  &trans  &trans  &trans  &trans        &trans  &trans  &trans    &trans    &trans  &trans
                    &trans  &trans  &trans        &trans  &trans  &trans
    >;
    };
    symbols {
// ---------------------------------------------------------------------------------------------
// |      |     |     |     |     |     | # |     |     |       |         |     |     |
// |      |     |     |     |     |     | # |     |     |       |         |      |     |
// |      |     |     |     |     |     | # |     |     |       |         |      |     |
//                    |     |     |     | # |     |     |       |

    bindings = <
&trans  &trans  &trans  &trans  &trans  &trans        &trans  &trans  &trans    &trans    &trans  &trans
&trans  &trans  &trans  &trans  &trans  &trans        &trans  &trans  &trans    &trans    &trans  &trans
&trans  &trans  &trans  &trans  &trans  &trans        &trans  &trans  &trans    &trans    &trans  &trans
                    &trans  &trans  &trans        &trans  &trans  &trans
    >;
};

  sys {
            bindings = <
&trans  &kp F1        &kp F2        &kp F3        &kp F4      &kp F5            &kp F6  &kp F7  &kp F8  &kp F9  &kp F10      &trans
&trans  &kp F11       &kp F12       &trans        &trans      &studio_unlock    &trans  &trans  &trans  &trans  &trans       &trans
&trans  &bt BT_SEL 0  &bt BT_SEL 1  &bt BT_SEL 2  &bt BT_CLR  &bt BT_CLR_ALL    &trans  &trans  &trans  &trans  &bootloader  &trans
                                    &trans        &trans      &trans            &trans  &trans  &trans
        >;
  };

    mouse {
// ---------------------------------------------------------------------------------------------
// |      |     |     |     |     |     | # |     |     |       |         |     |     |
// |      |     |     |     |     |     | # |     |     |       |         |      |     |
// |      |     |     |     |     |     | # |     |     |       |         |      |     |
//                    |     |     |     | # |     |     |       |

  bindings = <
&trans  &trans  &trans  &trans  &trans  &trans        &trans  &trans  &trans    &trans    &trans  &trans
&trans  &trans  &trans  &trans  &trans  &trans        &trans  &trans  &trans    &trans    &trans  &trans
&trans  &trans  &trans  &trans  &trans  &trans        &trans  &trans  &trans    &trans    &trans  &trans
                  &trans  &trans  &trans        &trans  &trans  &trans
  >;
};

  conditional_layers {
    compatible = "zmk,conditional-layers";

    system {
        if-layers = <3 4>;
        then-layer = <5>;
    };
};
